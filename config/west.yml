## config/west.yml
```yaml
manifest:
  #defaults:
  #  revision: v0.3
  remotes:
    - name: zmkfirmware
      url-base: https://github.com/zmkfirmware
    - name: lever-tech
      url-base: https://github.com/lever-tech
  projects:
    - name: zmk
      remote: zmkfirmware
      revision: main
      import: app/west.yml
    - name: flake-firmware
      remote: lever-tech
      revision: main
  self:
    path: config
```
